/*
 * Copyright (c) 2016, The Linux Foundation. All rights reserved.
 *
 * This program is free software; you can redistribute it and/or modify
 * it under the terms of the GNU General Public License version 2 and
 * only version 2 as published by the Free Software Foundation.
 *
 * This program is distributed in the hope that it will be useful,
 * but WITHOUT ANY WARRANTY; without even the implied warranty of
 * MERCHANTABILITY or FITNESS FOR A PARTICULAR PURPOSE.  See the
 * GNU General Public License for more details.
 */

/dts-v1/;

#include "exynos7270-tizen_solis-r12.dtsi"

/ {
	model = "SOLIS-BT";
	compatible = "samsung,exynos7270";
	samsung,exynos-id = <0x00007270 12 0>;
	samsung,borad-id = <0x00007270 0>;
};
