## drivers/staging/tizen/Kconfig
```kconfig
menu "Tizen"

config TIZEN
	bool "Tizen Drivers"
	---help---
	  Enable support for various drivers needed on the Tizen platform

endmenu
```

## drivers/video/fbdev/exynos/decon_7570/panels/Kconfig
```kconfig
config EXYNOS_DECON_LCD
	depends on EXYNOS_DECON_7570
	bool "Select LCD panel driver"

config EXYNOS_DECON_LCD_S6E8AA0
	depends on EXYNOS_DECON_LCD && EXYNOS_MIPI_DSI
	tristate "S6E8AA0 AMOLED HD LCD driver(720 x 1280)"

config EXYNOS_DECON_LCD_S6E8AA5X01
	depends on EXYNOS_DECON_LCD && EXYNOS_MIPI_DSI
	tristate "S6E8AA5X01 AMOLED HD LCD driver(720 x 1280)"

config EXYNOS_DECON_LCD_S6E36W1X01
	depends on EXYNOS_DECON_LCD && EXYNOS_MIPI_DSI
	tristate "S6E36W1X01 AMOLED HD LCD driver(360 x 360)"

config EXYNOS_DECON_LCD_S6E36W2X01
        depends on EXYNOS_DECON_LCD && EXYNOS_MIPI_DSI
        tristate "S6E36W2X01 AMOLED HD LCD driver(360 x 360)"

config COPR_SUPPORT
	bool "S6E36W2X01 Panel COPR Support"
	depends on EXYNOS_DECON_LCD_S6E36W2X01
	default n
	help
	  Say Y here if you want support COPR.

config EXYNOS_HLPM_TEST_SUPPORT
	bool "S6E36W2X01 Panel HLPM Support"
	depends on EXYNOS_DECON_LCD_S6E36W2X01
	default n
```

## kernel/swap/Kconfig
```kconfig
#
# General SWAP options
#


menu "SWAP_DA"

config SWAP_KERNEL_IMMUTABLE
	bool "SWAP cannot modify kernel"

config SWAP_HOOK_TASKDATA
	bool "SWAP TD hooks"

config SWAP_HOOK_USAUX
	bool "SWAP US hooks"
	depends on ARM64
	select SWAP_HOOK_TASKDATA

config SWAP_HOOK_SYSCALL
	bool "SWAP syscall hook"
	depends on ARM64

config SWAP_HOOK_SWITCH_TO
	bool "SWAP context hooks"

config SWAP_HOOK_ENERGY
	bool "SWAP energy estimation hooks"

config SWAP_HOOK_FILE_OPS
	bool "SWAP file operations hooks"

config SWAP_HOOK_SIGNAL
	bool "SWAP signal hook"

endmenu # "SWAP_DA"
```

## security/mstdrv/Kconfig
```kconfig
#
config MST_LDO
        bool "MST LDO kernel driver"
        default n
        help
          This enables the MST LDO kernel driver.
```
