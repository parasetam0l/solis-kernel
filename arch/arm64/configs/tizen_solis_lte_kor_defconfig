## arch/arm64/configs/tizen_solis_lte_kor_defconfig
```kconfig
CONFIG_SOLIS_LTE=y
CONFIG_SOLIS_LTE_KOR=y
CONFIG_USB_SLP_RNDIS_SUPPORT=y
CONFIG_MCU_IPC=y
CONFIG_SHM_IPC=y
CONFIG_SEC_SIPC_MODEM_IF=y
```

## arch/arm64/configs/tizen_solis_lte_na_tmo_defconfig
```kconfig
CONFIG_SOLIS_LTE=y
CONFIG_SOLIS_LTE_NA_TMO=y
CONFIG_USB_SLP_RNDIS_SUPPORT=y
CONFIG_CP_SECURE_BOOT_RESET=y
CONFIG_MCU_IPC=y
CONFIG_SHM_IPC=y
CONFIG_SEC_SIPC_MODEM_IF=y
```

## arch/arm64/configs/tizen_solis_lte_na_vzw_defconfig
```kconfig
CONFIG_SOLIS_LTE=y
CONFIG_SOLIS_LTE_NA_VZW=y
CONFIG_USB_SLP_RNDIS_SUPPORT=y
CONFIG_MCU_IPC=y
CONFIG_SHM_IPC=y
CONFIG_SEC_SIPC_MODEM_IF=y
```

## drivers/gpu/drm/tgm/Kconfig
```kconfig
config DRM_TGM
	tristate "TGM supports display rendering and buffer allocation in the Tizen"
	depends on DRM
	help
	  Tizen Graphics Manager composed of TDM and TBM.
	  TDM show many constiuents on the screen.
	  TBM can be allocated graphics attribute buffer.

config DRM_TDM
	bool "TDM shows graphics attribute on the screen"
	depends on DRM_TGM
	help
	  Tizen Display Manager supports display rendering.

config DRM_TDM_IRQ
	bool "IRQ supports Vsync Interrupt"
	depends on DRM_TDM
	help
	  IRQ supports Vsync Interrupt.

config DRM_TDM_IRQ_EXYNOS
	bool "Supports Exynos Vsync Interrupt"
	depends on DRM_TDM_IRQ
	help
	  IRQ supports Vsync Interrupt.

config DRM_TDM_DPMS_CTRL
       bool "DRM TDM DPMS IOCTL"
       depends on DRM_TDM
       help
       Choose this option if you want to use dpms ioctl.

config DRM_TDM_PP
	bool "Supports PP feature"
	depends on DRM_TDM
	help
	  Supports post-processing feature.

config DRM_TDM_PP_MSC
	bool "TDM PP MSC"
	depends on DRM_TDM_PP
	help
	  Choose this option if you want to use MSC for PP.

config DRM_TBM
	bool "TBM allocates graphics buffer"
	depends on DRM_TGM
	help
	  Tizen Buffer Manager supports buffer allocation.

config DRM_TBM_GEM
	bool "TBM_GEM supports graphics execution memory"
	depends on DRM_TBM
	help
	  GEM supports Graphics buffer.

config DRM_TBM_GEM_ION
	bool "Supports graphics execution memory based on ION"
	depends on DRM_TBM_GEM
	help
	  GEM supports Graphics buffer.

config DRM_TBM_GEM_DMA_MAPPING
	bool "Supports graphics execution memory based on DMA Mapping"
	depends on DRM_TBM_GEM
	help
	  GEM supports Graphics buffer.

config DISPLAY_EARLY_DPMS
	bool "Display early DPMS"
	depends on DRM_TGM
	help
	  Choose this option if you want to use early dpms feature.
```

## drivers/media/platform/exynos/fimc-is2/ischain/fimc-is-v3_20_0/Kconfig
```kconfig
config FIMC_IS_V3_20_0
	bool "Use fimc-is v3.20.0"
	depends on EXYNOS_FIMC_IS
	default n
	help
	  fimc-is version 3.20.0
```

## drivers/media/platform/exynos/fimc-is2/vendor/Kconfig
```kconfig
choice
	prompt "Use vender features"
	depends on VIDEO_EXYNOS_FIMC_IS2
	default VENDER_DEFAULT
	help
	  Use the vender specific features.

config VENDER_DEFAULT
        bool "Default"
config VENDER_MCD
        bool "MCD"
config VENDER_PSV
        bool "PSV"
endchoice

source "drivers/media/platform/exynos/fimc-is2/vendor/psv/Kconfig"
source "drivers/media/platform/exynos/fimc-is2/vendor/mcd/Kconfig"
```

## drivers/motor/Kconfig
```kconfig
config MOTOR_DRV_MAX77803
	default n
	depends on MFD_MAX77803
	help
	  If you say yes here you will get support for the
	  motor of Maxim MAX77803 PMIC.

config MOTOR_DRV_MAX8997
	tristate "Maxim MAX8997 motor"
	default n
	depends on MFD_MAX8997
	help
	  If you say yes here you will get support for the
	  motor of Maxim MAX8997 PMIC.

config MOTOR_DRV_ISA1000A
	tristate "ISA1000A motor"
	default n
	help
	  Say Y to enalbe the ISA1000A IC.

config MOTOR_DRV_ISA1200
	tristate "ISA1200 motor"
	default n
	depends on I2C
	help
	  Say Y to enalbe the ISA1200 IC.

config MOTOR_DRV_ISA1400
	tristate "ISA1400 motor"
	default n
	depends on I2C
	help
	  Say Y to enalbe the ISA1400 IC.

config HAPTIC_ISA1200
	tristate "ISA1200 motor"
	default n
	depends on I2C
	help
	  Say Y to enalbe the ISA1200 IC.

config HAPTIC_ISA1400
	tristate "ISA1400 motor"
	default n
	depends on I2C
	help
	  Say Y to enalbe the ISA1400 IC.

config DC_MOTOR
	tristate "DC_Motor"
	default n
	help
	  Say Y to enable DC Motor

config MOTOR_INFO
	tristate "PRODUCT NAME OF MOTOR"
	default n
	help
	  Say Y to know about motor name

config FF_DC_VIBRATOR
	tristate "FF_DC_VIBRATOR"
	default n
	help
	 Say Y to enable ff dc vibrator

config MOTOR_DRV_DRV2624
	tristate "drv2624 motor"
	default n
	help
	 Say Y to enable the drv2624 IC

config MOTOR_DRV_ZH915
	tristate "zh915 motor"
	default n
	help
	 Say Y to enable the zh915 IC
```

## drivers/sensorhub/Kconfig
```kconfig
menu "Sensor HUB Drivers"

#
# sensor drivers configuration
#

source "drivers/sensorhub/brcm/Kconfig"
endmenu
```

## drivers/sensorhub/brcm/Kconfig
```kconfig
#
# sensor drivers configuration
#
config SENSORS_SYSFS
	tristate "Sensors sysfs"
	help
	  Support sysfs for sensors.
          If you say yes here you get sysfs support for
	  sensor factory test.
	  To compile this driver as a module, choose M here: the
	  module will be called sensors_core.

config SENSORS_SSP
	tristate "Sensors ssp"
	default n
	depends on SPI
	help
	  ssp driver for sensor hub.
          If you say yes here you get ssp support for
	  sensor hub.
	  To compile this driver as a module, choose M here: the
	  module will be called ssp.

config SENSORS_SSP_BBD
	tristate "Sensors ssp brcm"
	default n
	depends on SPI
	help
	  ssp driver for sensor hub.
          If you say yes here you get ssp support for
	  sensor hub.
	  To compile this driver as a module, choose M here: the
	  module will be called ssp.

config SENSORS_SSP_SENSORHUB
	tristate "Sensors ssp sensorhub"
	default n
	depends on SPI
	help
	  ssp sensor hub driver for sensor hub.
          If you say yes here you get ssp support for
	  sensor hub.
	  To compile this driver as a module, choose M here: the
	  module will be called ssp.

config SENSORS_SSP_FACTORY
	tristate "ssp factory"
	depends on SENSORS_SSP
	default n
	help
	  ssp sensor hub driver for factory test.
          If you say yes here you can enable fatory drvier for
	  factory test.
	  To compile this driver as a module, choose M here: the
	  module will be called ssp.

config SENSORS_SSP_ACCELEROMETER_SENSOR
	tristate "Sensors ssp acceleromter sensor"
	default n
	depends on SPI
	help
          If you say yes here, accelererometer sensor supported
	  To compile this driver as a module, choose M here: the
	  module will be called ssp.

config SENSORS_SSP_GYRO_SENSOR
	tristate "Sensors ssp gyro sensor"
	default n
	depends on SPI
	help
          If you say yes here, gyro sensor supported
	  To compile this driver as a module, choose M here: the
	  module will be called ssp.

config SENSORS_SSP_MAGNETIC_SENSOR
	tristate "Sensors ssp magnetic sensor"
	default n
	depends on SPI
	help
          If you say yes here, magnetic sensor supported
	  To compile this driver as a module, choose M here: the
	  module will be called ssp.

config SENSORS_SSP_PRESSURE_SENSOR
	tristate "Sensors ssp pressure sensor"
	default n
	depends on SPI
	help
          If you say yes here, pressure sensor supported
	  To compile this driver as a module, choose M here: the
	  module will be called ssp.

config SENSORS_SSP_LIGHT_SENSOR
	tristate "Sensors ssp light sensor"
	default n
	depends on SPI
	help
          If you say yes here, light sensor supported
	  To compile this driver as a module, choose M here: the
	  module will be called ssp.

config SENSORS_SSP_TEMP_HUMID_SENSOR
	tristate "Sensors ssp temp_humid sensor"
	default n
	depends on SPI
	help
          If you say yes here, temp_humid sensor supported
	  To compile this driver as a module, choose M here: the
	  module will be called ssp.
config SENSORS_SSP_SKIN_TEMP
	tristate "Sensors ssp skin temp sensor"
	depends on SPI
	help
	  If you say yes here, skin temp sensor supported
	  Two temp sensor will be working
config SENSORS_SSP_ROT_VECTOR_SENSOR
	tristate "Sensors ssp rotation vector sensor"
	default n
	depends on SPI
	help
          If you say yes here, rotation vector sensor supported
	  To compile this driver as a module, choose M here: the
	  module will be called ssp.

config SENSORS_SSP_HRM_SENSOR
	tristate "Sensors ssp hrm sensor"
	default n
	depends on SPI
	help
          If you say yes here, hrm sensor supported
	  To compile this driver as a module, choose M here: the
	  module will be called ssp.

config SENSORS_SSP_UV_SENSOR
	tristate "Sensors ssp uv sensor"
	default n
	depends on SPI
	help
          If you say yes here, uv sensor supported
	  To compile this driver as a module, choose M here: the
	  module will be called ssp.

config SENSORS_SSP_FRONT_HRM_SENSOR
	tristate "Sensors ssp front hrm sensor"
	default n
	depends on SPI
	help
          If you say yes here, front hrm sensor supported
	  To compile this driver as a module, choose M here: the
	  module will be called ssp.

config SENSORS_SSP_GSR_SENSOR
	tristate "Sensors ssp gsr sensor"
	default n
	depends on SPI
	help
          If you say yes here, gsr sensor supported
	  To compile this driver as a module, choose M here: the
	  module will be called ssp.

config SENSORS_SSP_ECG_SENSOR
	tristate "Sensors ssp ecg sensor"
	default n
	depends on SPI
	help
          If you say yes here, ecg sensor supported
	  To compile this driver as a module, choose M here: the
	  module will be called ssp.

config SENSORS_SSP_GRIP_SENSOR
	tristate "Sensors ssp grip sensor"
	default n
	depends on SPI
	help
          If you say yes here, grip sensor supported
	  To compile this driver as a module, choose M here: the
	  module will be called ssp.

config SENSORS_SSP_LPM_MOTION
	tristate "Sensors ssp lpm motion"
	default n
	depends on SPI
	help
          If you say yes here, lpm motion supported
	  To compile this driver as a module, choose M here: the
	  module will be called ssp.

config BCM_GPS_LOGGING
	tristate "Broadcom GPS logging"
	default n
	depends on SPI
	help
          If you say yes here, lpm motion supported
	  To compile this driver as a module, choose M here: the
	  module will be called ssp.

config SENSORS_BBD_LEGACY_PATCH
	bool "Added Broadcom legacy patch-ram (DEVELOPMENT)"
	depends on SPI
	help
	 If you select this, target can be add legacy patch-ram
	 internally in kernel space. And if you choose its usage
	 or not in DTS configuration, your target will be use
	 legacy patch-ram. This will be led to increase memory usage.

config SENSORS_BBD_SPI_PORT
	int "Broadcom SPI port number"
	depends on SPI && SENSORS_SSP_BBD
	default 99

source "drivers/sensorhub/brcm/factory/Kconfig"
source "drivers/sensorhub/brcm/bbdpl/Kconfig"
```

## drivers/sensorhub/brcm/factory/Kconfig
```kconfig
#
# sensor drivers configuration
#
config SENSORS_SSP_BMI168
	tristate "Sensors ssp bmi168"
	default n
	depends on SPI
	help
	  bmi160 file for factory test in ssp driver.
          If you say yes here you get bmi168 support for
	  factory test.
	  To compile this driver as a module, choose M here: the
	  module will be called ssp.

config SENSORS_SSP_K6DS3TR
	tristate "Sensors ssp k6ds3tr"
	default n
	depends on SPI
	help
	  k6ds3tr file for factory test in ssp driver.
          If you say yes here you get k6ds3tr support for
	  factory test.
	  To compile this driver as a module, choose M here: the
	  module will be called ssp.

config SENSORS_SSP_LSM6DSL
	tristate "Sensors ssp lsm6dsl"
	default n
	depends on SPI
	help
	  lsm6dsl file for factory test in ssp driver.
          If you say yes here you get lsm6dsl support for
	  factory test.
	  To compile this driver as a module, choose M here: the
	  module will be called ssp.

config SENSORS_SSP_YAS537
	tristate "Sensors ssp yas537"
	default n
	depends on SPI
	help
	  yas537 file for factory test in ssp driver.
          If you say yes here you get yas537 support for
	  factory test.
	  To compile this driver as a module, choose M here: the
	  module will be called ssp.

config SENSORS_SSP_LPS25H
	tristate "Sensors ssp lps25h"
	default n
	depends on SPI
	help
	  lps25h file for factory test in ssp driver.
          If you say yes here you get lps25h support for
	  factory test.
	  To compile this driver as a module, choose M here: the
	  module will be called ssp.

config SENSORS_SSP_TSL2584
	tristate "Sensors ssp tsl2584"
	default n
	depends on SPI
	help
	  tsl2584 file for factory test in ssp driver.
          If you say yes here you get tsl2584 support for
	  factory test.
	  To compile this driver as a module, choose M here: the
	  module will be called ssp.

config SENSORS_SSP_CM3323
	tristate "Sensors ssp cm3323"
	default n
	depends on SPI
	help
	  cm3323 file for factory test in ssp driver.
          If you say yes here you get cm3323 support for
	  factory test.
	  To compile this driver as a module, choose M here: the
	  module will be called ssp.

config SENSORS_SSP_SHTW1
	tristate "Sensors ssp shtw1"
	default n
	depends on SPI
	help
	  shtw1 file for factory test in ssp driver.
          If you say yes here you get shtw1 support for
	  factory test.
	  To compile this driver as a module, choose M here: the
	  module will be called ssp.

config SENSORS_SSP_AD45251
	tristate "Sensors ssp ad45251"
	default n
	depends on SPI
	help
	  adpd45251 file for factory test in ssp driver.
          If you say yes here you get ad45251 support for
	  factory test.
	  To compile this driver as a module, choose M here: the
	  module will be called ssp.

config SENSORS_SSP_PPS960
	tristate "Sensors ssp pps960"
	default n
	depends on SPI
	help
	  pps960 file for factory test in ssp driver.
          If you say yes here you get pps960 support for
	  factory test.
	  To compile this driver as a module, choose M here: the
	  module will be called ssp.

config SENSORS_SSP_MAX86902
	tristate "Sensors ssp max86902"
	default n
	depends on SPI
	help
	  max86902 file for factory test in ssp driver.
          If you say yes here you get max86902 support for
	  factory test.
	  To compile this driver as a module, choose M here: the
	  module will be called ssp.

config SENSORS_SSP_HM121
	tristate "Sensors ssp hm121"
	default n
	depends on SPI
	help
	  hm121 file for factory test in ssp driver.
          If you say yes here you get hm121 support for
	  factory test.
	  To compile this driver as a module, choose M here: the
	  module will be called ssp.

config SENSORS_SSP_ADS1292
	tristate "Sensors ssp ads1292"
	default n
	depends on SPI
	help
	  ads1292 file for factory test in ssp driver.
          If you say yes here you get ads1292 support for
	  factory test.
	  To compile this driver as a module, choose M here: the
	  module will be called ssp.

config SENSORS_SSP_SX9310
	tristate "Sensors ssp sx9310"
	default n
	depends on SPI
	help
	  sx9310 file for factory test in ssp driver.
          If you say yes here you get sx9310 support for
	  factory test.
	  To compile this driver as a module, choose M here: the
	  module will be called ssp.
```

## drivers/sensors/Kconfig
```kconfig
#
# AP-controlled Sensor drivers configuration
#

menu "AP-controlled Sensor devices"

config SENSORS_CORE
		depends on !SENSORS_SYSFS
        bool "Sensors Class Support"
        help
          This option enables the sensor sysfs class in /sys/class/sensors.
          You'll need this to do anything useful with sensorss. If unsure, say N.

source "drivers/sensors/lps22hb/Kconfig"
endmenu
```

## drivers/sensors/lps22hb/Kconfig
```kconfig
config INPUT_LPS22HB
	tristate "STMicroelectronics LPS22HB sensor"
	depends on (I2C || SPI) && SYSFS
	help
	   This driver support the STMicroelectronics LPS22HB sensor.
	   To compile this driver as a module, choose M here. The module
	   will be called lps22hb.

config INPUT_LPS22HB_I2C
	bool "Use I2C interface for LPS22HB"
	depends on INPUT_LPS22HB
	depends on I2C
	help
	  Use I2C insterface for LPS22HB sensor

config INPUT_LPS22HB_SPI
	bool "Use SPI interface for LPS22HB"
	depends on INPUT_LPS22HB
	depends on SPI
	help
	  Use SPI insterface for LPS22HB sensor
```
